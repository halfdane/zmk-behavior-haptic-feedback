/*
 * Copyright (c) 2020 The ZMK Contributors
 *
 * SPDX-License-Identifier: MIT
 */

/ {
    behaviors {
        /omit-if-no-ref/ brr: haptic_feedback {
            compatible = "zmk,behavior-haptic-feedback";
            #binding-cells = <1>;
        };
    };
};