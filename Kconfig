## Kconfig
```kconfig
# Haptic Feedback using a rumble motor
#
# Copyright (c) 2019 Nordic Semiconductor
#
# SPDX-License-Identifier: LicenseRef-Nordic-5-Clause
#

DT_COMPAT_ZMK_BEHAVIOR_HAPTIC_FEEDBACK := zmk,behavior-haptic-feedback

config ZMK_BEHAVIOR_HAPTIC_FEEDBACK
		bool
		default $(dt_compat_enabled,$(DT_COMPAT_ZMK_BEHAVIOR_HAPTIC_FEEDBACK))
```

## dts/bindings/behaviors/zmk,behavior-haptic-feedback.yaml
```yaml
# Copyright (c) 2021 The ZMK Contributors
# SPDX-License-Identifier: MIT

description: Haptic feedback node

compatible: "zmk,behavior-haptic-feedback"

include: one_param.yaml
```
